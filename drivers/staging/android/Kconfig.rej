## drivers/staging/android/Kconfig.rej
```kconfig
diff a/drivers/staging/android/Kconfig b/drivers/staging/android/Kconfig	(rejected hunks)
@@ -21,8 +21,9 @@ config ASHMEM
 	  POSIX SHM but with different behavior and sporting a simpler
 	  file-based API.
 
-	  It is, in theory, a good memory allocator for low-memory devices,
-	  because it can discard shared memory units when under memory pressure.
+config ANDROID_LOGGER
+	tristate "Android log driver"
+	default n
 
 config LOGCAT_SIZE
 	int "Adjust android log buffer sizes"
```
